/dts-v1/;
/plugin/;

/ {
	compatible = "allwinner,sun50i-h618";

	fragment@0 {
		target-path = "/";
		__overlay__ {
			gygeslink_powerkey {
				compatible = "gpio-keys";

				powerkey {
					label = "gygeslink-powerkey";
					linux,code = <116>;
					gpios = <&pio 8 13 1>;
					debounce-interval = <50>;
					wakeup-source;
				};
			};
		};
	};
};